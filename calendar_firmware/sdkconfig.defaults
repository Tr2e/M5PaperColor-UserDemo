## calendar_firmware/sdkconfig.defaults
```kconfig
CONFIG_PARTITION_TABLE_CUSTOM=y
CONFIG_PARTITION_TABLE_CUSTOM_FILENAME="partitions.csv"
CONFIG_ESPTOOLPY_FLASHMODE_DIO=y
CONFIG_ESPTOOLPY_FLASHFREQ_80M=y
CONFIG_ESPTOOLPY_FLASHSIZE_16MB=y
CONFIG_COMPILER_OPTIMIZATION_SIZE=y
CONFIG_ESP_DEFAULT_CPU_FREQ_MHZ_160=y
CONFIG_ESP_MAIN_TASK_STACK_SIZE=12288
CONFIG_SPIRAM=y
CONFIG_SPIRAM_MODE_OCT=y
CONFIG_SPIRAM_SPEED_40M=y
CONFIG_SPIRAM_CLK_IO=30
CONFIG_SPIRAM_CS_IO=26
CONFIG_SPIRAM_USE_MALLOC=y
CONFIG_SPIRAM_MALLOC_ALWAYSINTERNAL=16384
CONFIG_SPIRAM_MALLOC_RESERVE_INTERNAL=32768
CONFIG_ESP_CONSOLE_USB_SERIAL_JTAG=y
CONFIG_ESP_CONSOLE_SECONDARY_NONE=y
CONFIG_LWIP_SNTP_MAX_SERVERS=3
CONFIG_I2C_BUS_BACKWARD_CONFIG=y
CONFIG_LOG_DEFAULT_LEVEL_INFO=y
```

## main/Kconfig.projbuild
```kconfig
menu "PaperColor local photo effects"

config PAPERCOLOR_OIL_PAINT
    bool "Enable offline oil-paint effect in the photo viewer"
    default n
    help
        Apply a deterministic RGB565 brush renderer to the currently displayed
        photo on the PaperColor itself. The resulting Canvas is submitted through
        the production M5GFX/ED2208 color conversion. This does not enable the
        retired experimental LUT or photo ditherer.

config PAPERCOLOR_OIL_PAINT_STACKED
    bool "Use accepted stacked-brush renderer"
    depends on PAPERCOLOR_OIL_PAINT
    default y
    help
        Five-pass detail-preserving renderer, with caller-owned PSRAM workspace
        and cooperative scheduling. Disable to retain the legacy oil renderer.

endmenu
```
